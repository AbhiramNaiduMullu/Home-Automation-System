/**
 * @cliArgs --board "/ti/boards/CC3235SF_LAUNCHXL" --rtos "tirtos" --product "simplelink_cc32xx_sdk@6.10.00.05"
 * @versions {"tool":"1.15.0+2826"}
 */

/**
 * Import the modules used in this configuration.
 */
const Display  = scripting.addModule("/ti/display/Display");
const Display1 = Display.addInstance();
const ADC      = scripting.addModule("/ti/drivers/ADC");
const ADC1     = ADC.addInstance();
const ADC2     = ADC.addInstance();
const GPIO     = scripting.addModule("/ti/drivers/GPIO", {}, false);
const GPIO3    = GPIO.addInstance();

/**
 * Write custom configuration values to the imported modules.
 */
Display1.$name      = "CONFIG_Display_0";
Display1.$hardware  = system.deviceData.board.components.XDS110UART;
Display1.uart.$name = "CONFIG_UART2_0";

ADC1.$name     = "CONFIG_ADC_0";
ADC1.$hardware = system.deviceData.board.components.OPA4342.subComponents.AIN3;

ADC2.$name     = "CONFIG_ADC_1";
ADC2.$hardware = system.deviceData.board.components.OPA4342.subComponents.AIN2;

GPIO3.$name              = "CONFIG_GPIO_0";
GPIO3.mode               = "Output";
GPIO3.initialOutputState = "High";
GPIO3.gpioPin.$assign    = "boosterpack.7";

const Power          = scripting.addModule("/ti/drivers/Power", {}, false);
Power.parkPins.$name = "ti_drivers_power_PowerCC32XXPins0";

/**
 * Pinmux solution for unlocked pins/peripherals. This ensures that minor changes to the automatic solver in a future
 * version of the tool will not impact the pinmux you originally saw.  These lines can be completely deleted in order to
 * re-solve from scratch.
 */
Display1.uart.uart.$suggestSolution              = "UART1";
Display1.uart.uart.txPin.$suggestSolution        = "ball.55";
Display1.uart.uart.txDmaChannel.$suggestSolution = "UDMA_CH11";
Display1.uart.uart.rxPin.$suggestSolution        = "ball.57";
Display1.uart.uart.rxDmaChannel.$suggestSolution = "UDMA_CH10";
ADC1.adc.$suggestSolution                        = "ADC0";
ADC1.adc.adcPin.$suggestSolution                 = "boosterpack.26";
ADC2.adc.$suggestSolution                        = "ADC0";
ADC2.adc.adcPin.$suggestSolution                 = "boosterpack.2";
